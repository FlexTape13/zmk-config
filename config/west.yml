## config/west.yml
```yaml
manifest:
  defaults:
    revision: v0.3
  remotes:
  - name: zmkfirmware
    url-base: https://github.com/zmkfirmware
  - name: FlexTape13
    url-base: https://github.com/FlexTape13
  projects:
  - name: zmk
    remote: zmkfirmware
    import: app/west.yml

  - name: zmk-config
    remote: FlexTape13
    revision: main
  - name: zmk-keyboards-splitminivan
    url: https://github.com/FlexTape13/zmk-keyboards-splitminivan
    revision: main
    path: modules/zmk-keyboards-splitminivan
  self:
    path: config
```
